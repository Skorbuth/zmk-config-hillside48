/* source keypos definitions */
#include "../zmk-nodefree-config/keypos_def/keypos_48keys_hillside.h"

/* map the hillside48's extra keys */
#define X_LT    &kp TAB
#define X_RT    &kp BACKSLASH

#define X_LM    &kp ESC
#define X_RM    &kp ENTER

#define X_LB    &kp LSHFT
#define X_MB    &kp K_MUTE &kp PRINTSCREEN
#define X_RB    &kp U

#define X_LH    &none &none
#define X_MH    NAV_BSPC NAV_DEL
#define X_RH    &none &none

/* activate bluetooth */
#define CONFIG_WIRELESS 1

/* source the main keymap */
#include "base.keymap"